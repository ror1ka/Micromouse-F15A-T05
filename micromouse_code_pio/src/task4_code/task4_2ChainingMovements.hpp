#pragma once

#include <Arduino.h>

#include "Micromouse.hpp"
// Defines `struct Command` and `MISSION`/`NUM_COMMANDS`. Generated by
// task4_code/image_processing_4_2.ipynb - do not hand-edit it, and do not
// include any of the other generated route headers alongside this one, since
// each of them defines `Command` again.
#include "task4_code/4_2_full_route.h"

// Task 4.2 runs one mission that is really two different problems back to back,
// and that is why it does not reuse chainMovement():
//
//   In the maze  the robot is in a corridor, axis aligned, moving whole cells.
//                The side LiDARs see two parallel walls, so the wall trim in
//                driveDistanceCruiseLidar is meaningful and worth having.
//
//   In the zone  the obstacle course is open floor with 100mm cylinders in it.
//                The robot crosses it on arbitrary headings, so the side LiDARs
//                are staring at walls and cylinders at oblique angles and the
//                "offset" they imply is noise - steering on it would drive the
//                robot into the thing it just measured. Worse, the front guard
//                would stop the robot FRONT_STOP_DISTANCE short of a cylinder it
//                was only ever going to drive *past*, and the move would return
//                having silently travelled less than it was told to.
//
// So the zone moves ('T' and 'D') run open of the LiDAR entirely, on encoders
// and the IMU heading hold. Clearance is the planner's job: the notebook dilates
// the obstacles by the robot's radius, so a path that exists is a path that fits.
//
// Command set, as emitted by build_master_mission():
//
//   'f'  forward one cell            (grid phase, LiDAR centred)
//   'l'  quarter turn left           (grid phase)
//   'r'  quarter turn right          (grid phase)
//   'T'  turn by value degrees, +ve = left/CCW   (zone phase)
//   'D'  drive value mm              (zone phase)
//   'S'  snap the heading back to the maze grid  (zone -> grid handover)

constexpr float MISSION_CELL_DISTANCE = 180.0f;

// Corridor moves can afford to be quick - the wall trim is correcting them.
constexpr int MISSION_DRIVE_PWM = 130;
constexpr int MISSION_TURN_PWM = 70;

// The zone runs slower. Nothing is correcting these moves except the heading
// hold, so any error they pick up is carried to the end of the course, and a
// slower move picks up less of it.
constexpr int MISSION_ZONE_DRIVE_PWM = 100;
// Lower again than MISSION_TURN_PWM. Zone turns are often 40 degrees or less,
// which is inside turnByAngleProfiled's 35 degree decel ramp for the whole turn,
// so the cap never reaches the flat top anyway - asking for more PWM here only
// makes the approach to the deadband harsher.
constexpr int MISSION_ZONE_TURN_PWM = 55;

// Turns smaller than this are not worth commanding: turnByAngleProfiled settles
// in a 1.2 degree deadband and cannot push below MIN_TURNING_PWM, so a 2 degree
// request is a bang-bang across the band rather than a turn. The notebook should
// be filtering these out too; this is the backstop.
constexpr float MISSION_MIN_TURN = 2.5f;
// Same idea for drives, against the drive deadband of 3mm.
constexpr float MISSION_MIN_DRIVE = 5.0f;

// Heading the robot is placed on, in the maze frame, in degrees CCW-positive.
// Must match START_HEADING in the notebook or every turn in the mission is
// referenced to the wrong grid.
constexpr float MISSION_START_HEADING = 0.0f;

// Runs a generated mission array.
//
// Heading bookkeeping: this function keeps its own accumulator of every turn it
// commands, in the mission's frame rather than the IMU's. It tracks what was
// *asked for* rather than what was achieved, which is exactly what 'S' needs -
// the residual between the commanded heading and the grid is the part the
// mission knows about and can correct.
//
// Movement now keeps an absolute heading of its own that agrees with this one
// turn for turn, so the two are redundant. They diverge in one place: a turn
// below MISSION_MIN_TURN is added here but never commanded, so Movement does not
// see it. 'S' takes the difference back out at the handover, which is where it
// matters. Drift beyond that is recovered by the first 'f' after the zone, whose
// wall trim re-centres the robot in the corridor.
inline void chainMission(Micromouse& mouse, const Command* mission, int count) {
    float heading = MISSION_START_HEADING;

    for (int i = 0; i < count; i++) {
        const char action = mission[i].action;
        const float value = mission[i].value;

        Serial.print(i + 1);
        Serial.print(F("/"));
        Serial.print(count);
        Serial.print(F(" "));

        switch (action) {
            case 'f': {
                // Swallow the whole run of forwards and drive it as one move, for
                // the reason chainMovement does: one accel and one decel instead
                // of one per cell, and one chance to pick up heading error
                // instead of one per cell.
                int cells = 1;
                while (i + 1 < count && mission[i + 1].action == 'f') {
                    cells++;
                    i++;
                }

                Serial.print(F("forward x"));
                Serial.println(cells);
                mouse.driveDistanceCruiseLidar(cells * MISSION_CELL_DISTANCE,
                                               MISSION_DRIVE_PWM);
                break;
            }

            case 'l':
                Serial.println(F("left"));
                mouse.turnByAngleProfiled(TURN_LEFT, MISSION_TURN_PWM);
                heading += TURN_LEFT;
                break;

            case 'r':
                Serial.println(F("right"));
                mouse.turnByAngleProfiled(TURN_RIGHT, MISSION_TURN_PWM);
                heading += TURN_RIGHT;
                break;

            case 'T':
                Serial.print(F("turn "));
                Serial.print(value, 1);
                Serial.println(F(" deg"));

                if (fabsf(value) < MISSION_MIN_TURN) {
                    Serial.println(F("  (below the deadband, skipped)"));
                } else {
                    mouse.turnByAngleProfiled(value, MISSION_ZONE_TURN_PWM);
                }
                // Accumulated whether or not it was commanded, so a skipped turn
                // is still accounted for and 'S' takes it out at the end.
                heading += value;
                break;

            case 'D':
                Serial.print(F("drive "));
                Serial.print(value, 1);
                Serial.println(F(" mm"));

                if (fabsf(value) < MISSION_MIN_DRIVE) {
                    Serial.println(F("  (below the deadband, skipped)"));
                } else {
                    // Deliberately not the Lidar variant. See the note at the top.
                    mouse.driveDistanceCruiseNoLidar(value, MISSION_ZONE_DRIVE_PWM);
                }
                break;

            case 'S': {
                // Leaving the zone on some arbitrary heading, about to hand back
                // to cell-at-a-time driving. Turn by however far the accumulated
                // heading is from the nearest quarter turn, so the grid phase
                // starts square to the corridor rather than a few degrees across
                // it - which over four or five cells is the difference between
                // clipping a wall and not.
                const float snapped = roundf(heading / 90.0f) * 90.0f;
                const float residual = Micromouse::normaliseAngle(snapped - heading);

                Serial.print(F("snap: heading "));
                Serial.print(heading, 1);
                Serial.print(F(" -> "));
                Serial.print(snapped, 1);
                Serial.print(F(" ("));
                Serial.print(residual, 1);
                Serial.println(F(" deg)"));

                if (fabsf(residual) >= MISSION_MIN_TURN) {
                    mouse.turnByAngleProfiled(residual, MISSION_ZONE_TURN_PWM);
                }
                heading = snapped;
                break;
            }

            default:
                Serial.print(F("unknown command '"));
                Serial.print(action);
                Serial.println(F("', skipping"));
                break;
        }
    }

    Serial.print(F("mission complete, heading "));
    Serial.println(Micromouse::normaliseAngle(heading), 1);
}

// Convenience overload for the generated array.
inline void chainMission(Micromouse& mouse) {
    chainMission(mouse, MISSION, NUM_COMMANDS);
}
